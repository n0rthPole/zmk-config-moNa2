## config/west.yml
```yaml
manifest:
  remotes:
    - name: zmkfirmware
      url-base: https://github.com/zmkfirmware
    - name: n0rthPole
      url-base: https://github.com/n0rthPole
    - name: caksoylar  # <-- new entry
      url-base: https://github.com/caksoylar
    - name: kot149
      url-base: https://github.com/kot149
    - name: yamaryu211
      url-base: https://github.com/yamaryu211
  projects:
    - name: zmk
      remote: zmkfirmware
      revision: main
      import: app/west.yml
      
    - name: zmk-pmw3610-driver
      remote: n0rthPole
      revision: main
      path: modules/zmk-pmw3610-driver
      
    - name: zmk-rgbled-widget  # <-- new entry
      remote: caksoylar
      revision: main
      path: modules/zmk-rgbled-widget
      
    - name: zmk-layout-shift
      remote: kot149
      revision: v1
      path: modules/zmk-layout-shift
      
    - name: zmk-xy-snap-module
      remote: yamaryu211
      revision: main
      path: modules/zmk-xy-snap-module
      
  self:
    path: config
```
